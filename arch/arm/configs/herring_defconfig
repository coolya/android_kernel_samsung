## sound/soc/codecs/Kconfig.voodoo
```kconfig
menuconfig SND_VOODOO
	bool "Voodoo sound driver"
	depends on SND_UNIVERSAL_WM8994 || SND_S3C24XX_SOC
	default y
	help
	  With this option enabled, the kernel compile an additionnal driver
	  that extend the existing sound driver

config SND_VOODOO_HP_LEVEL_CONTROL
	bool "Add headphone amplifier level control"
	depends on SND_VOODOO
	default y
	help
	  Adds a control allowing to adjust the analog gain of the headphone
	  amplifier

config SND_VOODOO_HP_LEVEL
	int "default level at boot 0-62"
	depends on SND_VOODOO_HP_LEVEL_CONTROL
	default 54 if MACH_HERRING=y || M110S=y
	default 47
	range 0 62
	help
	  Default headphone amplifier level. Take care not setting it to high,
	  it would introduce hiss for people not using the control app

config SND_VOODOO_RECORD_PRESETS
	bool "Microphone recording presets"
	depends on SND_VOODOO
	default y
	help
	  Recording presets with Dynamic Range Compression auto-gain
	  on microphone:
	    - Original
	    - High sensitivity
	    - Balanced (recommanded, default)
	    - Loud environment - concert

config SND_VOODOO_FM
	bool "FM radio: frequency response and levels optimizations"
	depends on SND_VOODOO && ARIES_EUR
	default n
	help
	  Adds a control to enable or disable the high-pass filter on FM radio

config SND_VOODOO_MODULE
	tristate "Build also as module (incomplete)"
	depends on SND_VOODOO && m && n
	default n
	help
	  requires additionnal source

config SND_VOODOO_DEVELOPMENT
	bool "Codec development tools (unsafe)"
	depends on SND_VOODOO
	default n
	help
	  Allow to codec dump registers and load register-address/value batchs
	  Powerful but also dangerous tool
```
