## arch/arm/configs/herring_defconfig
```kconfig
CONFIG_EXPERIMENTAL=y
# CONFIG_LOCALVERSION_AUTO is not set
CONFIG_SYSVIPC=y
CONFIG_CGROUPS=y
CONFIG_CGROUP_DEBUG=y
CONFIG_CGROUP_FREEZER=y
CONFIG_CGROUP_CPUACCT=y
CONFIG_RESOURCE_COUNTERS=y
CONFIG_CGROUP_SCHED=y
CONFIG_RT_GROUP_SCHED=y
CONFIG_BLK_DEV_INITRD=y
CONFIG_EMBEDDED=y
CONFIG_KALLSYMS_ALL=y
CONFIG_ASHMEM=y
# CONFIG_AIO is not set
# CONFIG_SLUB_DEBUG is not set
CONFIG_MODULES=y
CONFIG_MODULE_FORCE_LOAD=y
CONFIG_MODULE_UNLOAD=y
CONFIG_MODULE_FORCE_UNLOAD=y
# CONFIG_BLK_DEV_BSG is not set
CONFIG_ARCH_S5PV210=y
CONFIG_S3C_LOWLEVEL_UART_PORT=2
CONFIG_S5P_HIGH_RES_TIMERS=y
CONFIG_S5PV210_SD_CH0_8BIT=y
CONFIG_MACH_HERRING=y
CONFIG_WIFI_CONTROL_FUNC=y
CONFIG_ARM_THUMBEE=y
CONFIG_FIQ_DEBUGGER=y
CONFIG_FIQ_DEBUGGER_CONSOLE=y
CONFIG_PREEMPT=y
CONFIG_AEABI=y
CONFIG_CMDLINE="console=ttyFIQ0"
CONFIG_CPU_FREQ=y
CONFIG_CPU_FREQ_LOG=y
CONFIG_CPU_FREQ_DEFAULT_GOV_ONDEMAND=y
CONFIG_CPU_FREQ_GOV_POWERSAVE=y
CONFIG_CPU_FREQ_GOV_USERSPACE=y
CONFIG_CPU_FREQ_GOV_CONSERVATIVE=y
CONFIG_CPU_IDLE=y
CONFIG_VFP=y
CONFIG_NEON=y
CONFIG_BINFMT_MISC=y
CONFIG_PM=y
CONFIG_WAKELOCK=y
CONFIG_APM_EMULATION=y
CONFIG_NET=y
CONFIG_PACKET=y
CONFIG_UNIX=y
CONFIG_NET_KEY=y
CONFIG_INET=y
CONFIG_INET_ESP=y
# CONFIG_NET_ACTIVITY_STATS is not set
# CONFIG_INET_XFRM_MODE_TUNNEL is not set
# CONFIG_INET_XFRM_MODE_BEET is not set
# CONFIG_INET_LRO is not set
CONFIG_IPV6=y
CONFIG_IPV6_PRIVACY=y
CONFIG_IPV6_ROUTER_PREF=y
CONFIG_IPV6_OPTIMISTIC_DAD=y
CONFIG_INET6_AH=y
CONFIG_INET6_ESP=y
CONFIG_INET6_IPCOMP=y
CONFIG_IPV6_MIP6=y
CONFIG_IPV6_TUNNEL=y
CONFIG_IPV6_MULTIPLE_TABLES=y
CONFIG_NETFILTER=y
CONFIG_NETFILTER_NETLINK_QUEUE=y
CONFIG_NETFILTER_NETLINK_LOG=y
CONFIG_NF_CONNTRACK=y
CONFIG_NF_CONNTRACK_EVENTS=y
CONFIG_NF_CT_PROTO_DCCP=y
CONFIG_NF_CT_PROTO_SCTP=y
CONFIG_NF_CT_PROTO_UDPLITE=y
CONFIG_NF_CONNTRACK_AMANDA=y
CONFIG_NF_CONNTRACK_FTP=y
CONFIG_NF_CONNTRACK_H323=y
CONFIG_NF_CONNTRACK_IRC=y
CONFIG_NF_CONNTRACK_NETBIOS_NS=y
CONFIG_NF_CONNTRACK_PPTP=y
CONFIG_NF_CONNTRACK_SANE=y
CONFIG_NF_CONNTRACK_SIP=y
CONFIG_NF_CONNTRACK_TFTP=y
CONFIG_NF_CT_NETLINK=y
CONFIG_NETFILTER_XT_TARGET_CLASSIFY=y
CONFIG_NETFILTER_XT_TARGET_CONNMARK=y
CONFIG_NETFILTER_XT_TARGET_LED=y
CONFIG_NETFILTER_XT_TARGET_MARK=y
CONFIG_NETFILTER_XT_TARGET_NFQUEUE=y
CONFIG_NETFILTER_XT_MATCH_COMMENT=y
CONFIG_NETFILTER_XT_MATCH_CONNBYTES=y
CONFIG_NETFILTER_XT_MATCH_CONNLIMIT=y
CONFIG_NETFILTER_XT_MATCH_CONNMARK=y
CONFIG_NETFILTER_XT_MATCH_CONNTRACK=y
CONFIG_NETFILTER_XT_MATCH_HASHLIMIT=y
CONFIG_NETFILTER_XT_MATCH_HELPER=y
CONFIG_NETFILTER_XT_MATCH_IPRANGE=y
CONFIG_NETFILTER_XT_MATCH_LENGTH=y
CONFIG_NETFILTER_XT_MATCH_LIMIT=y
CONFIG_NETFILTER_XT_MATCH_MAC=y
CONFIG_NETFILTER_XT_MATCH_MARK=y
CONFIG_NETFILTER_XT_MATCH_OWNER=y
CONFIG_NETFILTER_XT_MATCH_POLICY=y
CONFIG_NETFILTER_XT_MATCH_PKTTYPE=y
CONFIG_NETFILTER_XT_MATCH_QUOTA=y
CONFIG_NETFILTER_XT_MATCH_STATE=y
CONFIG_NETFILTER_XT_MATCH_STATISTIC=y
CONFIG_NETFILTER_XT_MATCH_STRING=y
CONFIG_NETFILTER_XT_MATCH_TIME=y
CONFIG_NETFILTER_XT_MATCH_U32=y
CONFIG_NF_CONNTRACK_IPV4=y
CONFIG_IP_NF_IPTABLES=y
CONFIG_IP_NF_MATCH_ADDRTYPE=y
CONFIG_IP_NF_MATCH_AH=y
CONFIG_IP_NF_MATCH_ECN=y
CONFIG_IP_NF_MATCH_TTL=y
CONFIG_IP_NF_FILTER=y
CONFIG_IP_NF_TARGET_REJECT=y
CONFIG_IP_NF_TARGET_LOG=y
CONFIG_NF_NAT=y
CONFIG_IP_NF_TARGET_MASQUERADE=y
CONFIG_IP_NF_TARGET_NETMAP=y
CONFIG_IP_NF_TARGET_REDIRECT=y
CONFIG_IP_NF_ARPTABLES=y
CONFIG_IP_NF_ARPFILTER=y
CONFIG_IP_NF_ARP_MANGLE=y
CONFIG_NET_SCHED=y
CONFIG_NET_SCH_HTB=y
CONFIG_NET_SCH_INGRESS=y
CONFIG_NET_CLS_U32=y
CONFIG_NET_EMATCH=y
CONFIG_NET_EMATCH_U32=y
CONFIG_NET_CLS_ACT=y
CONFIG_NET_ACT_POLICE=y
CONFIG_NET_ACT_GACT=y
CONFIG_NET_ACT_MIRRED=y
CONFIG_PHONET=y
CONFIG_BT=y
CONFIG_BT_L2CAP=y
CONFIG_BT_SCO=y
CONFIG_BT_RFCOMM=y
CONFIG_BT_RFCOMM_TTY=y
CONFIG_BT_HCIUART=y
CONFIG_BT_HCIUART_H4=y
CONFIG_WIRELESS=y
CONFIG_WIRELESS_EXT=y
CONFIG_RFKILL=y
CONFIG_RFKILL_PM=y
CONFIG_RFKILL_INPUT=y
CONFIG_INPUT_MISC=y
CONFIG_GYRO_K3G=y
CONFIG_INPUT_UINPUT=y
# CONFIG_VT is not set
CONFIG_UEVENT_HELPER_PATH=""
CONFIG_MTD=y
CONFIG_MTD_CONCAT=y
CONFIG_MTD_CHAR=y
CONFIG_MTD_BLOCK=y
CONFIG_MTD_ONENAND=y
CONFIG_MTD_ONENAND_SAMSUNG=y
CONFIG_BLK_DEV_LOOP=y
CONFIG_BLK_DEV_RAM=y
CONFIG_BLK_DEV_RAM_SIZE=8192
CONFIG_APANIC=y
CONFIG_SCSI=y
CONFIG_BLK_DEV_SD=y
CONFIG_CHR_DEV_SG=y
CONFIG_NETDEVICES=y
CONFIG_IFB=y
CONFIG_INPUT_EVDEV=y
CONFIG_KEYPAD_CYPRESS_TOUCH=y
# CONFIG_INPUT_MOUSE is not set
CONFIG_INPUT_TOUCHSCREEN=y
CONFIG_TOUCHSCREEN_MXT224=y
CONFIG_INPUT_KEYCHORD=y
CONFIG_INPUT_GPIO=y
# CONFIG_SERIAL_8250 is not set
CONFIG_SERIAL_SAMSUNG=y
CONFIG_SERIAL_SAMSUNG_CONSOLE=y
# CONFIG_CRESPO_LEGACY_MODEM is not set
CONFIG_SAMSUNG_MODEMCTL=y
CONFIG_PN544=y
CONFIG_HW_RANDOM=y
CONFIG_I2C=y
CONFIG_I2C_CHARDEV=y
CONFIG_I2C_GPIO=y
CONFIG_I2C_S3C2410=y
CONFIG_GPIO_SYSFS=y
CONFIG_POWER_SUPPLY=y
CONFIG_BATTERY_MAX17040=y
CONFIG_BATTERY_S5PC110=y
CONFIG_OPTICAL_GP2A=y
# CONFIG_HWMON is not set
CONFIG_REGULATOR=y
CONFIG_REGULATOR_MAX8998=y
CONFIG_MFD_MAX8998=y
CONFIG_MEDIA_SUPPORT=y
CONFIG_VIDEO_DEV=y
# CONFIG_IR_CORE is not set
CONFIG_VIDEO_S5K4ECGX=y
CONFIG_VIDEO_S5KA3DFX=y
CONFIG_VIDEO_SAMSUNG=y
CONFIG_VIDEO_SAMSUNG_V4L2=y
CONFIG_VIDEO_FIMC=y
CONFIG_VIDEO_FIMC_RANGE_NARROW=y
# CONFIG_VIDEO_FIMC_MIPI is not set
CONFIG_VIDEO_MFC50=y
CONFIG_VIDEO_JPEG_V2=y
CONFIG_FB=y
CONFIG_FB_S3C=y
CONFIG_FB_S3C_NR_BUFFERS=2
CONFIG_FB_S3C_TL2796=y
# CONFIG_FB_S3C_LVDS is not set
CONFIG_BACKLIGHT_LCD_SUPPORT=y
CONFIG_LCD_CLASS_DEVICE=y
CONFIG_BACKLIGHT_CLASS_DEVICE=y
# CONFIG_BACKLIGHT_GENERIC is not set
# CONFIG_VGA_CONSOLE is not set
# CONFIG_FRAMEBUFFER_CONSOLE is not set
CONFIG_SOUND=y
CONFIG_SND=y
CONFIG_SND_SOC=y
CONFIG_SND_S3C24XX_SOC=y
CONFIG_SND_S5P_WM8994=y
# CONFIG_HID_SUPPORT is not set
CONFIG_USB_GADGET=y
CONFIG_USB_GADGET_VBUS_DRAW=500
CONFIG_USB_ANDROID=y
CONFIG_USB_ANDROID_ADB=y
CONFIG_USB_ANDROID_MASS_STORAGE=y
CONFIG_USB_ANDROID_RNDIS=y
CONFIG_USB_ANDROID_RNDIS_WCEIS=y
CONFIG_USB_ANDROID_RNDIS_DWORD_ALIGNED=y
CONFIG_MMC=y
CONFIG_MMC_UNSAFE_RESUME=y
CONFIG_MMC_SDHCI=y
CONFIG_MMC_SDHCI_S3C=y
CONFIG_MMC_SDHCI_S3C_DMA=y
CONFIG_SWITCH=y
CONFIG_RTC_CLASS=y
CONFIG_RTC_DRV_S3C=y
CONFIG_STAGING=y
# CONFIG_STAGING_EXCLUDE_BUILD is not set
CONFIG_ANDROID=y
CONFIG_ANDROID_BINDER_IPC=y
CONFIG_ANDROID_LOGGER=y
CONFIG_ANDROID_RAM_CONSOLE=y
CONFIG_ANDROID_RAM_CONSOLE_ERROR_CORRECTION=y
CONFIG_ANDROID_TIMED_GPIO=y
CONFIG_ANDROID_LOW_MEMORY_KILLER=y
CONFIG_EXT2_FS=y
CONFIG_EXT4_FS=y
CONFIG_EXT4_USE_FOR_EXT23=y
# CONFIG_EXT4_FS_XATTR is not set
# CONFIG_EXT4_DEBUG is not set
# CONFIG_DNOTIFY is not set
CONFIG_INOTIFY=y
CONFIG_MSDOS_FS=y
CONFIG_VFAT_FS=y
CONFIG_TMPFS=y
CONFIG_TMPFS_POSIX_ACL=y
CONFIG_YAFFS_FS=y
CONFIG_CRAMFS=y
CONFIG_ROMFS_FS=y
CONFIG_SYSV_FS=y
CONFIG_PARTITION_ADVANCED=y
CONFIG_BSD_DISKLABEL=y
CONFIG_SOLARIS_X86_PARTITION=y
CONFIG_NLS_CODEPAGE_437=y
CONFIG_NLS_ASCII=y
CONFIG_NLS_ISO8859_1=y
CONFIG_MAGIC_SYSRQ=y
CONFIG_DEBUG_KERNEL=y
# CONFIG_DEBUG_PREEMPT is not set
CONFIG_DEBUG_RT_MUTEXES=y
CONFIG_DEBUG_SPINLOCK=y
CONFIG_DEBUG_MUTEXES=y
CONFIG_DEBUG_SPINLOCK_SLEEP=y
CONFIG_DEBUG_INFO=y
# CONFIG_RCU_CPU_STALL_DETECTOR is not set
CONFIG_SYSCTL_SYSCALL_CHECK=y
# CONFIG_ARM_UNWIND is not set
CONFIG_DEBUG_USER=y
CONFIG_DEBUG_ERRORS=y
CONFIG_DEBUG_S3C_UART=2
CONFIG_CRC_CCITT=y
CONFIG_BCM4329=m
CONFIG_BCM4329_FW_PATH="/vendor/firmware/fw_bcm4329.bin"
CONFIG_BCM4329_NVRAM_PATH="/vendor/firmware/nvram_net.txt"
CONFIG_PPP=y
CONFIG_PPP_DEFLATE=y
CONFIG_PPP_BSDCOMP=y
CONFIG_PPP_MPPE=y
CONFIG_PPPOLAC=y
CONFIG_PPPOPNS=y
# CONFIG_SWAP is not set
CONFIG_DEBUG_FS=y
CONFIG_EFI_PARTITION=y
# CONFIG_LEGACY_PTYS is not set
CONFIG_PVR_SGX=y
CONFIG_PVR_BUILD_RELEASE=y
# CONFIG_PVR_BUILD_DEBUG is not set
CONFIG_PVR_NEED_PVR_DPF=y
CONFIG_PVR_NEED_PVR_ASSERT=y
CONFIG_PVR_PERCONTEXT_PB=y
CONFIG_PVR_ACTIVE_POWER_MANAGEMENT=y
CONFIG_PVR_ACTIVE_POWER_LATENCY_MS=100
CONFIG_PVR_SGX_LOW_LATENCY_SCHEDULING=y
CONFIG_PVR_USSE_EDM_STATUS_DEBUG=y
CONFIG_PVR_DUMP_MK_TRACE=y
# CONFIG_PVR_PDUMP is not set
CONFIG_PANIC_TIMEOUT=5
CONFIG_SENSORS_KR3DM=y
CONFIG_SENSORS_AK8973=y
CONFIG_MD=y
CONFIG_BLK_DEV_DM=y
CONFIG_DM_DEBUG=y
CONFIG_DM_CRYPT=y
CONFIG_DM_UEVENT=y
CONFIG_LOCALVERSION_AUTO=y
CONFIG_PRINTK_TIME=y
CONFIG_SAMSUNG_JACK=y
CONFIG_CRYPTO_HMAC=y
CONFIG_CRYPTO_MD5=y
CONFIG_CRYPTO_SHA1=y
CONFIG_CRYPTO_AES=y
CONFIG_CRYPTO_DES=y
CONFIG_CRYPTO_TWOFISH=y
CONFIG_USB_SWITCH_FSA9480=y
CONFIG_NET_ACTIVITY_STATS=y
CONFIG_UID_STAT=y
```

## arch/arm/mach-s5pv210/Kconfig
```kconfig
# arch/arm/mach-s5pv210/Kconfig
#
# Copyright (c) 2010 Samsung Electronics Co., Ltd.
#		http://www.samsung.com/
#
# Licensed under GPLv2

# Configuration options for the S5PV210/S5PC110

if ARCH_S5PV210

config CPU_S5PV210
	bool
	select PLAT_S5P
	select S3C_PL330_DMA
	select S5P_EXT_INT
	help
	  Enable S5PV210 CPU support

config S5PV210_SETUP_I2C1
	bool
	depends on S3C_DEV_I2C1
	default	y
	help
	  Common setup code for i2c bus 1.

config S5PV210_SETUP_I2C2
	bool
	depends on S3C_DEV_I2C2
	default	y
	help
	  Common setup code for i2c bus 2.

config S5PV210_SETUP_FB_24BPP
	bool
	help
          Common setup code for S5PV210 with an 24bpp RGB display helper.

config S5PV210_SETUP_SDHCI
        bool
        select S5PV210_SETUP_SDHCI_GPIO
        help
          Internal helper functions for S5PV210 based SDHCI systems

config S5PV210_SETUP_SDHCI_GPIO
	bool
	help
	  Common setup code for SDHCI gpio.

config S5PV210_POWER_DOMAIN
	bool
	depends on REGULATOR
	default y
	help
	  Enable S5PV210 power domain support.

# machine support

config MACH_AQUILA
	bool "Samsung Aquila"
	select CPU_S5PV210
	select ARCH_SPARSEMEM_ENABLE
	select S5PV210_SETUP_FB_24BPP
	select S3C_DEV_FB
	help
	  Machine support for the Samsung Aquila target based on S5PC110 SoC

config MACH_GONI
	bool "GONI"
	select CPU_S5PV210
	select ARCH_SPARSEMEM_ENABLE
	help
	  Machine support for Samsung GONI board
	  S5PC110(MCP) is one of package option of S5PV210

comment "MMC/SD slot setup"
depends on PLAT_S5P

menu "Use 8-bit bus width"
config S5PV210_SD_CH0_8BIT
bool "Channel 0"
depends on PLAT_S5P
default n
help
IF channel 0 uses 8-bit bus, channel 1 is disabled.

config S5PV210_SD_CH2_8BIT
bool "Channel 2"
depends on PLAT_S5P
default n
help
IF channel 2 uses 8-bit bus, channel 3 is disabled.
endmenu

config S5PC110_DEV_ONENAND
	bool
	default y if CPU_S5PV210
	help 
	  Compile in platform device definition for OneNAND1 controller

config MACH_SMDKV210
	bool "SMDKV210"
	select CPU_S5PV210
	select ARCH_SPARSEMEM_ENABLE
	select SAMSUNG_DEV_ADC
	select SAMSUNG_DEV_TS
	select S3C_DEV_WDT
	select HAVE_S3C2410_WATCHDOG
	help
	  Machine support for Samsung SMDKV210

config MACH_SMDKC110
	bool "SMDKC110"
	select CPU_S5PV210
	select ARCH_SPARSEMEM_ENABLE
	select S3C_DEV_WDT
	select HAVE_S3C2410_WATCHDOG
	help
	  Machine support for Samsung SMDKC110
	  S5PC110(MCP) is one of package option of S5PV210

config MACH_HERRING
	bool "Herring"
	select CPU_S5PV210
	select ARCH_DISCONTIGMEM_ENABLE
	select S3C_DEV_WDT
	select HAVE_S3C2410_WATCHDOG
	select S3C_DEV_I2C1
	select S3C_DEV_I2C2
	select HAVE_PWM
	select ARCH_HAS_CPUFREQ
	select S3C_DEV_HSMMC
	select S3C_DEV_HSMMC1 if !S5PV210_SD_CH0_8BIT
	select S3C_DEV_HSMMC2
	select S3C_DEV_HSMMC3 if !S5PV210_SD_CH2_8BIT
	select S5PV210_SETUP_SDHCI
	select S5PV210_POWER_DOMAIN
	help
	  Machine support for Herring

config S5PV210_SETUP_FB
	bool
	depends on FB_S3C
	default y
	help
	  Common setup code for FIMD controller.

config S5P_ADC
	bool	"S5PXXXX ADC driver"
	depends on PLAT_S5P
	default y
	help
	  ADC ( A/D Conversion ) driver for Samsung S5PXXXX

config S5PV210_SETUP_FIMC0
	bool
	depends on VIDEO_FIMC
	default y
	help
	  Common setup code for FIMC controller 0.

config S5PV210_SETUP_FIMC1
	bool
	depends on VIDEO_FIMC
	default y
	help
	  Common setup code for FIMC controller 1.

config S5PV210_SETUP_FIMC2
	bool
	depends on VIDEO_FIMC
	default y
	help
	  Common setup code for FIMC controller 2.

config S5PV210_SETUP_CSIS
	bool
	depends on VIDEO_FIMC
	default y
	help
	  Common setup code for MIPI-CSIS

config WIFI_CONTROL_FUNC
       bool "Enable WiFi control function abstraction"
       help
         Enables Power/Reset/Carddetect function abstraction
endif
```

## arch/arm/plat-s5p/Kconfig
```kconfig
# arch/arm/plat-s5p/Kconfig
#
# Copyright (c) 2009 Samsung Electronics Co., Ltd.
#		http://www.samsung.com/
#
# Licensed under GPLv2

config PLAT_S5P
	bool
	depends on (ARCH_S5P6440 || ARCH_S5P6442 || ARCH_S5PC100 || ARCH_S5PV210)
	default y
	select ARM_VIC
	select NO_IOPORT
	select ARCH_REQUIRE_GPIOLIB
	select S3C_GPIO_TRACK
	select S5P_GPIO_DRVSTR
	select SAMSUNG_GPIOLIB_4BIT
	select S3C_GPIO_CFG_S3C64XX
	select S3C_GPIO_PULL_UPDOWN
	select S3C_GPIO_CFG_S3C24XX
	select PLAT_SAMSUNG
	select SAMSUNG_CLKSRC
	select SAMSUNG_IRQ_VIC_TIMER
	select SAMSUNG_IRQ_UART
	help
	  Base platform code for Samsung's S5P series SoC.

config SYSTIMER_S5P
	bool
	depends on (ARCH_S5P6442 || ARCH_S5PV210)
	default y
	help
	  Support System Timer for S5P Series


config S5P_EXT_INT
	bool
	help
	  Use the external interrupts (other than GPIO interrupts.)
	  Note: Do not choose this for S5P6440.

# FB part
config S5P_DEV_FB
	bool
	depends on FB_S3C
	default y
	help
	  Compile in platform device definitions for FIMD controller

config S5P_HIGH_RES_TIMERS
	bool "HRtimer and Dynamic Tick support"
	select GENERIC_TIME
	select GENERIC_CLOCKEVENTS
	select HIGH_RES_TIMERS
	select HRT_RTC
	select NO_HZ
	default n
	help
	  Support for HRtimer and Dynamic Tick system.

config HRT_RTC
	bool
	depends on S5P_HIGH_RES_TIMERS
	default y
	help
	  RTC and System timer are used as HRT

# MFC part
config S5P_DEV_MFC
	bool
	default n
	help
	  Compile in platform device definitions for MFC

config S5P_SETUP_MFC
	bool
	default n
	help
	  Common setup code for MFC
```

## drivers/gpu/pvr/Kconfig
```kconfig
config PVR_SGX
	tristate "PowerVR SGX support"
	depends on ARCH_S5PV210
	help
	  Enable this option to build support for the PowerVR SGX 3D core.

	  To compile this driver as a module, choose M here:
	  this will generate two modules, called pvrsrvkm and s3c_lcd.

choice
	prompt "PowerVR build type"
	depends on PVR_SGX
	default PVR_BUILD_RELEASE

config PVR_BUILD_RELEASE
	bool "Release"

config PVR_BUILD_DEBUG
	bool "Debug"

endchoice

# Release build debugging options

config PVR_NEED_PVR_DPF
	bool "Enable debugging messages in release build"
	depends on PVR_BUILD_RELEASE

config PVR_NEED_PVR_ASSERT
	bool "Enable assertions in release build"
	depends on PVR_BUILD_RELEASE

# Debugging options

config PVR_DEBUG_MEMORY
	bool "Record memory-related debugging information"
	depends on PVR_BUILD_DEBUG
	default y

config PVR_DEBUG_BRIDGE_KM
	bool "Collect bridge statistics"
	depends on PVR_BUILD_DEBUG
	default y

config PVR_DEBUG_TRACE_BRIDGE_KM
	bool "Trace bridge calls"
	depends on PVR_DEBUG_BRIDGE_KM
	default n

config PVR_DEBUG_BRIDGE_KM_DISPATCH_TABLE
	bool "Dump bridge dispatch table entries"
	depends on PVR_BUILD_DEBUG
	default n


#
# General options
#

config PVR_PERCONTEXT_PB
	bool "Per-context parameter buffer (recommended)"
	depends on PVR_SGX
	default y

config PVR_ACTIVE_POWER_MANAGEMENT
	bool "Support for active power management (recommended)"
	depends on PVR_SGX
	default y

config PVR_ACTIVE_POWER_LATENCY_MS
	int "Active power event latency (ms)"
	depends on PVR_ACTIVE_POWER_MANAGEMENT
	default 100

config PVR_SGX_LOW_LATENCY_SCHEDULING
	bool "Enable low-latency scheduling"
	depends on PVR_SGX
	default y

config PVR_USSE_EDM_STATUS_DEBUG
	bool "Trace microkernel status"
	depends on PVR_SGX
	default y if PVR_BUILD_DEBUG

config PVR_DUMP_MK_TRACE
	bool "Dump microkernel trace on HW recovery"
	depends on PVR_USSE_EDM_STATUS_DEBUG
	default y

config PVR_PDUMP
	bool "Support for parameter dumping (Pdump)"
	depends on PVR_SGX
	default n
```
