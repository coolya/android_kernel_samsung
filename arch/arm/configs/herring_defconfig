## drivers/media/video/samsung/Kconfig
```kconfig
config VIDEO_SAMSUNG
	bool "Samsung Multimedia Devices"
	depends on VIDEO_CAPTURE_DRIVERS && VIDEO_V4L2
	select VIDEO_FIXED_MINOR_RANGES
	default n
	---help---
	  This is a representative video4linux configuration for Samsung multimedia devices.

config VIDEO_SAMSUNG_V4L2
	bool "V4L2 API for digital camera to be contributed by samsung"
	depends on VIDEO_DEV && VIDEO_SAMSUNG
	default n
	---help---
	 This feature is for new V4L2 APIs all about digital camera

if CPU_S5PV210
source "drivers/media/video/samsung/fimc/Kconfig"
source "drivers/media/video/samsung/mfc50/Kconfig"
source "drivers/media/video/samsung/jpeg_v2/Kconfig"
#source "drivers/media/video/samsung/tv20/Kconfig"
#source "drivers/media/video/samsung/tsi/Kconfig"
if CPU_S5PV210_EVT1
#source "drivers/media/video/samsung/rotator/Kconfig"
#source "drivers/media/video/samsung/g2d/Kconfig"
endif
endif
```

## drivers/media/video/samsung/fimc/Kconfig
```kconfig
config VIDEO_FIMC
	bool "Samsung Camera Interface (FIMC) driver"
	depends on VIDEO_SAMSUNG && ARCH_S5PV210
	default n
	help
	  This is a video4linux driver for Samsung FIMC device.

choice
depends on VIDEO_FIMC
prompt "Select CSC Range config"
default VIDEO_FIMC_RANGE_NARROW
config VIDEO_FIMC_RANGE_NARROW
	bool "Narrow"
	depends on VIDEO_FIMC && ARCH_S5PV210
	---help---
	  RGB <-> YUV Color Conversion Narrow Range Equation

config VIDEO_FIMC_RANGE_WIDE
	bool "Wide"
	depends on VIDEO_FIMC && ARCH_S5PV210
	---help---
	  RGB <-> YUV Color Conversion Wide Range Equation
endchoice	

config VIDEO_FIMC_DEBUG
	bool "FIMC driver debug messages"
	depends on VIDEO_FIMC

config VIDEO_FIMC_MIPI
	bool "MIPI-CSI2 Slave Interface support"
	depends on VIDEO_FIMC && ARCH_S5PV210
	default y
```

## drivers/media/video/samsung/mfc50/Kconfig
```kconfig
#
# Configuration for Multi Format Codecs (MFC)
#
#
config VIDEO_MFC50
	bool "Samsung MFC (Multi Format Codec - FIMV 5.0) Driver" 
	depends on VIDEO_SAMSUNG && CPU_S5PV210
	default n
	select	S5P_SETUP_MFC 
	select	S5P_DEV_MFC 
	---help---
	  This is a Samsung Multi Format Codecs (MFC) FIMV V5.0 - driver for Samsung S5PC110

config VIDEO_MFC_MAX_INSTANCE
	int "Maximum size of MFC instance (1-4)"
	range 1 4
	depends on VIDEO_MFC50
	default 4

config VIDEO_MFC50_DEBUG
	bool "print MFC debug message"
	depends on VIDEO_MFC50
	default n
```

## drivers/media/video/samsung/tv20/Kconfig
```kconfig
#
# Configuration for TV-OUT/HDMI
#

config VIDEO_TV20
	bool "Samsung TV Driver"
	depends on VIDEO_SAMSUNG
	default y
	---help---
	  This is a TV driver for Samsung S5P platform

config HDMI_CEC
	bool "HDMI CEC driver support."
	depends on VIDEO_TV20 && CPU_S5PV210
	default n
	---help---
	  This is a HDMI CEC driver for Samsung SMDK_S5PV210
	  Check dev node (major 10, minor 242)

config HDMI_HPD
	bool "HDMI HPD driver support."
	depends on VIDEO_TV20 && CPU_S5PV210
	default n
	---help---
	  This is a HDMI HPD driver for Samsung SMDK_S5PV210
	  Check dev node (major 10, minor 243)

config TV_FB
	bool "TV frame buffer driver support."
	select FB_CFB_FILLRECT
	select FB_CFB_COPYAREA
	select FB_CFB_IMAGEBLIT

	depends on VIDEO_TV20 && FB && CPU_S5PV210
	default n
	---help---

config USER_ALLOC_TVOUT
	bool "Support pre allocated frame buffer memory."
	depends on VIDEO_TV20 && TV_FB
	default n
	---help---
	  TV Driver doesn't allocate memory for frame buffer.
	  So, before enabling TV out, the frame buffer should be allocated.

config TV_FB_NUM
	int "Index of TV frame buffer"
	depends on VIDEO_TV20 && TV_FB && !USER_ALLOC_TVOUT
	default 5
	---help---
```

## drivers/misc/samsung_modemctl/onedram_cdma/Kconfig
```kconfig
#
# OneDRAM configuration
#
config DPRAM_BUILT_IN
	tristate "onedram driver built-in"

	---help---
	  By default, n

	  When in doubt, say N.
```

## drivers/net/wimax/Kconfig
```kconfig
#
# WiMAX LAN device drivers configuration
#


comment "Enable WiMAX (Networking options) to see the WiMAX drivers"
	depends on WIMAX = n

if WIMAX

menu "WiMAX Wireless Broadband devices"

source "drivers/net/wimax/i2400m/Kconfig"
source "drivers/net/wimax/cmc7xx/Kconfig"

endmenu

endif
```

## drivers/net/wimax/cmc7xx/Kconfig
```kconfig
comment "Enable MMC support to see CMC7xx driver"
	depends on MMC = n

config WIMAX_CMC7XX
	bool "Samsung WiMax CMC7xx chipset support"
	depends on WIMAX && MMC
	default n

config WIMAX_CMC7XX_DEBUG
	bool "Samsung WiMax CMC7xx debug log"
	depends on WIMAX_CMC7XX
	default n
```

## drivers/video/samsung/Kconfig
```kconfig
#
# S3C Video configuration
#

config FB_S3C
	tristate "S3C Framebuffer support"
	select FB_CFB_FILLRECT
	select FB_CFB_COPYAREA
	select FB_CFB_IMAGEBLIT
	select FRAMEBUFFER_CONSOLE_DETECT_PRIMARY
	depends on FB && ARCH_S5PV210
	default n
	---help---
	  This enables support for Samsung Display Controller (FIMD)

config FB_S3C_SPLASH_SCREEN
        bool "SPLASH_SCREEN on LCD"
        depends on FB_S3C
	default n

config FB_S3C_LCD_INIT
        bool "LCD init in kernel"
        depends on FB_S3C
	default y

config FB_S3C_DEBUG
        bool "S3C Framebuffer debug messages"
        depends on FB_S3C

config FB_S3C_TRACE_UNDERRUN
	bool "S3C Framebuffer FIFO underrun trace"
	depends on FB_S3C

config FB_S3C_DEFAULT_WINDOW
	int "Default Window (0-4)"
	depends on FB_S3C
	default "2"
	---help---
	  This indicates the default window number, and which is used as console framebuffer

config FB_S3C_NR_BUFFERS
	int "Number of frame buffers (1-3)"
	depends on FB_S3C
	default "1"
	---help---
	  This indicates the number of buffers for pan display,
	  1 means no pan display and
	  2 means the double size of video buffer will be allocated for default window

config FB_S3C_VIRTUAL
	bool "Virtual Screen"
	depends on FB_S3C
	default n
	---help---
	  This uses 1920 x 1080 virtual screen.

config FB_S3C_X_VRES
	int "xres_virtual"
	depends on FB_S3C && FB_S3C_VIRTUAL
	default "1920"
	help
	  This indicates var.xres_virtual which has to be bigger than var.xres.

config FB_S3C_Y_VRES
	int "yres_virtual"
	depends on FB_S3C && FB_S3C_VIRTUAL
	default "1080"
	help
	  This indicates var.yres_virtual which has to be bigger than var.yres.

choice
depends on FB_S3C
prompt "Select LCD Type"
default FB_S3C_LTE480WV
config FB_S3C_LTE480WV
	bool "LTE480WV"
	depends on (MACH_SMDKV210 || MACH_SMDKC110)
	---help---
	  This enables support for Samsung LTE480WV 4.8\" WVGA LCD panel

config FB_S3C_HT101HD1
	bool "HT101HD1"
	depends on MACH_SMDKV210
	---help---
	  This enables support for HT101HD1 WXVGA(1366*768) LCD panel
endchoice

config FB_S3C_TL2796
        bool "TL2796"
        depends on FB_S3C
        select SPI
        select SPI_GPIO
        select SPI_BITBANG
        ---help---
          This enables support for Samsung TL2796 WVGA LCD panel

config FB_S3C_LVDS
	bool "LVDS"
	depends on FB_S3C && (ARCH_S5PV210)
	default y
	---help---
	  This enables support for Samsung LVDS LCD panel

config FB_S3C_AMS701KA
	bool "AMS701KA"
	depends on FB_S3C && (ARCH_S5PV210)
	select SPI
	select SPI_GPIO
	default n
	---help---
	  This enables support for Samsung AMS701KA LCD panel

config FB_S3C_MDNIE
	bool "Samsung MDNIE"
	depends on FB_S3C
	depends on FB_S3C && (ARCH_S5PV210)
	default "0"
	---help---
	  This enables support for Samsung MDNIE feature

config FB_S3C_CMC623
	bool "Samsung CMC623"
	depends on FB_S3C && (ARCH_S5PV210)
	default "0"
	---help---
	This enables support for Samsung CMC623 feature
```

## sound/soc/codecs/Kconfig
```kconfig
# Helper to resolve issues with configs that have SPI enabled but I2C
# modular, meaning we can't build the codec driver in with I2C support.
# We use an ordered list of conditional defaults to pick the appropriate
# setting - SPI can't be modular so that case doesn't need to be covered.
config SND_SOC_I2C_AND_SPI
	tristate
	default m if I2C=m
	default y if I2C=y
	default y if SPI_MASTER=y

config SND_SOC_ALL_CODECS
	tristate "Build all ASoC CODEC drivers"
	select SND_SOC_L3
	select SND_SOC_AC97_CODEC if SND_SOC_AC97_BUS
	select SND_SOC_AD1836 if SPI_MASTER
	select SND_SOC_AD193X if SND_SOC_I2C_AND_SPI
	select SND_SOC_AD1980 if SND_SOC_AC97_BUS
	select SND_SOC_ADS117X
	select SND_SOC_AD73311 if I2C
	select SND_SOC_AK4104 if SPI_MASTER
	select SND_SOC_AK4535 if I2C
	select SND_SOC_AK4642 if I2C
	select SND_SOC_AK4671 if I2C
	select SND_SOC_CQ0093VC if MFD_DAVINCI_VOICECODEC
	select SND_SOC_CS4270 if I2C
	select SND_SOC_MAX9877 if I2C
	select SND_SOC_DA7210 if I2C
	select SND_SOC_PCM3008
	select SND_SOC_SPDIF
	select SND_SOC_SSM2602 if I2C
	select SND_SOC_STAC9766 if SND_SOC_AC97_BUS
	select SND_SOC_TLV320AIC23 if I2C
	select SND_SOC_TLV320AIC26 if SPI_MASTER
	select SND_SOC_TLV320AIC3X if I2C
	select SND_SOC_TPA6130A2 if I2C
	select SND_SOC_TLV320DAC33 if I2C
	select SND_SOC_TWL4030 if TWL4030_CORE
	select SND_SOC_TWL6040 if TWL4030_CORE
	select SND_SOC_UDA134X
	select SND_SOC_UDA1380 if I2C
	select SND_SOC_WM2000 if I2C
	select SND_SOC_WM8350 if MFD_WM8350
	select SND_SOC_WM8400 if MFD_WM8400
	select SND_SOC_WM8510 if SND_SOC_I2C_AND_SPI
	select SND_SOC_WM8523 if I2C
	select SND_SOC_WM8580 if I2C
	select SND_SOC_WM8711 if SND_SOC_I2C_AND_SPI
	select SND_SOC_WM8727
	select SND_SOC_WM8728 if SND_SOC_I2C_AND_SPI
	select SND_SOC_WM8731 if SND_SOC_I2C_AND_SPI
	select SND_SOC_WM8750 if SND_SOC_I2C_AND_SPI
	select SND_SOC_WM8753 if SND_SOC_I2C_AND_SPI
	select SND_SOC_WM8776 if SND_SOC_I2C_AND_SPI
	select SND_SOC_WM8900 if I2C
	select SND_SOC_WM8903 if I2C
	select SND_SOC_WM8904 if I2C
	select SND_SOC_WM8940 if I2C
	select SND_SOC_WM8955 if I2C
	select SND_SOC_WM8960 if I2C
	select SND_SOC_WM8961 if I2C
	select SND_SOC_WM8971 if I2C
	select SND_SOC_WM8974 if I2C
	select SND_SOC_WM8978 if I2C
	select SND_SOC_WM8988 if SND_SOC_I2C_AND_SPI
	select SND_SOC_WM8990 if I2C
	select SND_SOC_WM8993 if I2C
	#select SND_SOC_WM8994 if MFD_WM8994
	select SND_SOC_WM8994 if I2C 
	select SND_SOC_WM9081 if I2C
	select SND_SOC_WM9090 if I2C
	select SND_SOC_WM9705 if SND_SOC_AC97_BUS
	select SND_SOC_WM9712 if SND_SOC_AC97_BUS
	select SND_SOC_WM9713 if SND_SOC_AC97_BUS
        help
          Normally ASoC codec drivers are only built if a machine driver which
          uses them is also built since they are only usable with a machine
          driver.  Selecting this option will allow these drivers to be built
          without an explicit machine driver for test and development purposes.

	  Support for the bus types used to access the codecs to be built must
	  be selected separately.

          If unsure select "N".

config SND_SOC_WM_HUBS
	tristate
	default y if SND_SOC_WM8993=y || SND_SOC_WM8994=y
	default m if SND_SOC_WM8993=m || SND_SOC_WM8994=m

config SND_SOC_AC97_CODEC
	tristate
	select SND_AC97_CODEC

config SND_SOC_AD1836
	tristate

config SND_SOC_AD193X
	tristate

config SND_SOC_AD1980
	tristate

config SND_SOC_AD73311
	tristate
	
config SND_SOC_ADS117X
	tristate

config SND_SOC_AK4104
	tristate

config SND_SOC_AK4535
	tristate

config SND_SOC_AK4642
	tristate

config SND_SOC_AK4671
	tristate

config SND_SOC_CQ0093VC
	tristate

# Cirrus Logic CS4270 Codec
config SND_SOC_CS4270
	tristate

config SND_SOC_DA7210
        tristate

# Cirrus Logic CS4270 Codec VD = 3.3V Errata
# Select if you are affected by the errata where the part will not function
# if MCLK divide-by-1.5 is selected and VD is set to 3.3V.  The driver will
# not select any sample rates that require MCLK to be divided by 1.5.
config SND_SOC_CS4270_VD33_ERRATA
	bool
	depends on SND_SOC_CS4270

config SND_SOC_CX20442
	tristate

config SND_SOC_L3
       tristate

config SND_SOC_PCM3008
       tristate

config SND_SOC_SPDIF
	tristate

config SND_SOC_SSM2602
	tristate

config SND_SOC_STAC9766
	tristate

config SND_SOC_TLV320AIC23
	tristate

config SND_SOC_TLV320AIC26
	tristate "TI TLV320AIC26 Codec support" if SND_SOC_OF_SIMPLE
	depends on SPI

config SND_SOC_TLV320AIC3X
	tristate

config SND_SOC_TLV320DAC33
	tristate

config SND_SOC_TWL4030
	select TWL4030_CODEC
	tristate

config SND_SOC_TWL6040
	tristate

config SND_SOC_UDA134X
       tristate

config SND_SOC_UDA1380
        tristate

config SND_SOC_WM8350
	tristate

config SND_SOC_WM8400
	tristate

config SND_SOC_WM8510
	tristate

config SND_SOC_WM8523
	tristate

config SND_SOC_WM8580
	tristate

config SND_SOC_WM8711
	tristate

config SND_SOC_WM8727
	tristate

config SND_SOC_WM8728
	tristate

config SND_SOC_WM8731
	tristate

config SND_SOC_WM8750
	tristate

config SND_SOC_WM8753
	tristate

config SND_SOC_WM8776
	tristate

config SND_SOC_WM8900
	tristate

config SND_SOC_WM8903
	tristate

config SND_SOC_WM8904
	tristate

config SND_SOC_WM8940
        tristate

config SND_SOC_WM8955
	tristate

config SND_SOC_WM8960
	tristate

config SND_SOC_WM8961
	tristate

config SND_SOC_WM8971
	tristate

config SND_SOC_WM8974
	tristate

config SND_SOC_WM8978
	tristate

config SND_SOC_WM8988
	tristate

config SND_SOC_WM8990
	tristate

config SND_SOC_WM8993
	tristate

config SND_SOC_WM8994
	tristate

config SND_SOC_WM9081
	tristate

config SND_SOC_WM9705
	tristate

config SND_SOC_WM9712
	tristate

config SND_SOC_WM9713
	tristate

# Amp
config SND_SOC_MAX9877
	tristate

config SND_SOC_TPA6130A2
	tristate

config SND_SOC_WM2000
	tristate

config SND_SOC_WM9090
	tristate

menuconfig SND_WM8994_EXTENSIONS
	bool "WM8994 Extensions"
	depends on SND_UNIVERSAL_WM8994 || SND_S3C24XX_SOC
	default y
	help
	  With this option enabled, the kernel compile an additionnal driver
	  that extend the existing sound driver

config SND_WM8994_EXTENSIONS_HP_LEVEL_CONTROL
	bool "Add headphone amplifier level control"
	depends on SND_WM8994_EXTENSIONS
	default y
	help
	  Adds a control allowing to adjust the analog gain of the headphone
	  amplifier

config SND_WM8994_EXTENSIONS_HP_LEVEL
	int "default level at boot 0-62"
	depends on SND_WM8994_EXTENSIONS_HP_LEVEL_CONTROL
	default 54 if MACH_HERRING=y || M110S=y
	default 47
	range 0 62
	help
	  Default headphone amplifier level. Take care not setting it to high,
	  it would introduce hiss for people not using the control app

config SND_WM8994_EXTENSIONS_RECORD_PRESETS
	bool "Microphone recording presets"
	depends on SND_WM8994_EXTENSIONS
	default y
	help
	  Recording presets with Dynamic Range Compression auto-gain
	  on microphone:
	    - Original
	    - High sensitivity
	    - Balanced (recommanded, default)
	    - Loud environment - concert

config SND_WM8994_EXTENSIONS_FM
	bool "FM radio: frequency response and levels optimizations"
	depends on SND_WM8994_EXTENSIONS && ARIES_EUR
	default n
	help
	  Adds a control to enable or disable the high-pass filter on FM radio

config SND_WM8994_EXTENSIONS_MODULE
	tristate "Build also as module (incomplete)"
	depends on SND_WM8994_EXTENSIONS && m && n
	default n
	help
	  requires additionnal source

config SND_WM8994_EXTENSIONS_DEVELOPMENT
	bool "Codec development tools (unsafe)"
	depends on SND_WM8994_EXTENSIONS
	default y
	help
	  Allow to codec dump registers and load register-address/value batchs
	  Powerful but also dangerous tool
```
